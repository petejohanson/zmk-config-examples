## manifest-dir/west.yml
```yaml
manifest:
  remotes:
    - name: zmkfirmware
      url-base: https://github.com/zmkfirmware
    - name: petejohanson
      url-base: https://github.com/petejohanson
  projects:
    - name: zmk
      remote: petejohanson
      revision: build/zmk-config-initial-work
      import: app/west.yml
  self:
    path: manifest-dir
```
